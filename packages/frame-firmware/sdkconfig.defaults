## packages/frame-firmware/sdkconfig.defaults
```kconfig
CONFIG_ESP32P4_SELECTS_REV_LESS_V3=y
CONFIG_ESP32P4_REV_MIN_100=y
CONFIG_BSP_LCD_TYPE_1280_800=y
CONFIG_CODEC_I2C_BACKWARD_COMPATIBLE=n
CONFIG_SPIRAM=y
CONFIG_SPIRAM_MODE_HEX=y
CONFIG_SPIRAM_SPEED_200M=y
CONFIG_CACHE_L2_CACHE_256KB=y
CONFIG_CACHE_L2_CACHE_LINE_128B=y
CONFIG_ESPTOOLPY_FLASHSIZE_16MB=y
```
